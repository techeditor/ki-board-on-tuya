## firmware/feature-probes/tuya_cloud_asr/Kconfig
```kconfig
menu "configure app (tuya_cloud_asr) "

config APP_CONFIG
    bool
    default y
    select ENABLE_AI_COMPONENTS

config TUYA_PRODUCT_ID
    string "product ID of project"
    default "p320pepzvmm1ghse"

endmenu
```
